/dts-v1/;
/plugin/;

/*
   Enable /dev/ttyS0 RTS and CTS signals on 40-pin GPIO header
   CTS is available on pin 36 of J8 header (GPIO 16)
   RTS is available on pin 11 of J8 header (GPIO 17)
*/

/ {
    compatible = "brcm,bcm2708";

    fragment@0 {
        target = <&uart1>;
        __overlay__ {
                pinctrl-names = "default";
                pinctrl-0 = <&uart1_gpio14 &uart1_ctsrts_gpio16>;
        };
    };
};
